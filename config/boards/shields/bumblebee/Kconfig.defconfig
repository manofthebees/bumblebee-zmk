## config/boards/shields/bumblebee/Kconfig.defconfig
```kconfig
if SHIELD_BUMBLEBEE_LEFT
 
config ZMK_KEYBOARD_NAME
    default "bumblebee"
 
config ZMK_SPLIT_ROLE_CENTRAL
    default y
 
endif
 
if SHIELD_BUMBLEBEE_LEFT || SHIELD_BUMBLEBEE_RIGHT
 
config ZMK_SPLIT
    default y
 
endif
```

## config/boards/shields/bumblebee/Kconfig.shield
```kconfig
config SHIELD_BUMBLEBEE_LEFT
    def_bool $(shields_list_contains,bumblebee_left)
    select SHIELD_BUMBLEBEE

config SHIELD_BUMBLEBEE_RIGHT
    def_bool $(shields_list_contains,bumblebee_right)
    select SHIELD_BUMBLEBEE
```
